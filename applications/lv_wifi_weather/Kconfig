## applications/lv_wifi_weather/Kconfig
```kconfig
menuconfig PKG_USING_LV_WIFI_WEATHER
    bool "LVGL Wi-Fi weather terminal"
    default n
    select PKG_USING_LVGL
    help
        A portable 800x480 Wi-Fi, city clock and weather UI for LVGL 8.3.

if PKG_USING_LV_WIFI_WEATHER

config LVWW_USING_RW007
    bool "Build the RW007 and Open-Meteo backend"
    default y
    depends on PKG_USING_RW007

config LVWW_USING_MOCK
    bool "Build the asynchronous mock backend"
    default n

config LVWW_BUILD_DEMO
    bool "Build the demo entry point"
    default y
    depends on LVWW_USING_MOCK || LVWW_USING_RW007

config LVWW_EVENT_QUEUE_DEPTH
    int "Backend event queue depth"
    range 4 16
    default 8

config LVWW_MOCK_STACK_SIZE
    int "Mock worker thread stack size"
    range 2048 8192
    default 4096

endif
```
